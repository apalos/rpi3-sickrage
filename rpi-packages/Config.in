## rpi-packages/Config.in
```kconfig
source "$BR2_EXTERNAL_RPI3_PACKAGES_PATH/package/deluge/Config.in"
source "$BR2_EXTERNAL_RPI3_PACKAGES_PATH/package/sickrage/Config.in"
```

## rpi-packages/package/deluge/Config.in
```kconfig
config BR2_PACKAGE_DELUGE
	bool "deluge"
	help
	  Deluge torrent client for RPI3

	  http://deluge-torrent.org/
```

## rpi-packages/package/sickrage/Config.in
```kconfig
config BR2_PACKAGE_SICKRAGE
	bool "sickrage"
	help
	  Sickrage for RPI3

	  https://sickrage.github.io/ 

if BR2_PACKAGE_RPI3_SICKRAGE

endif
```
